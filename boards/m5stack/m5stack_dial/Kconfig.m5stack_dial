## boards/m5stack/m5stack_dial/Kconfig.m5stack_dial
```kconfig
# M5Stack Dial board configuration

# Copyright (c) 2023 Martin Kiepfer <mrmarteng@teleschirm.org>
# SPDX-License-Identifier: Apache-2.0

config BOARD_M5STACK_DIAL
	select SOC_ESP32S3_FN8
	select SOC_ESP32S3_PROCPU if BOARD_M5STACK_DIAL_ESP32S3_PROCPU
	select SOC_ESP32S3_APPCPU if BOARD_M5STACK_DIAL_ESP32S3_APPCPU
```

## boards/m5stack/m5stack_dial/board.yml
```yaml
board:
  name: m5stack_dial
  full_name: M5Dial
  vendor: m5stack
  socs:
  - name: esp32s3
```
